## fsl-community-bsp/sources/meta-wvsnp-pkgs/conf/layer.conf
```bitbake
# We have a conf and classes directory, add to BBPATH
BBPATH .= ":${LAYERDIR}"
# We have a packages directory, add to BBFILES
BBFILES += "${LAYERDIR}/recipes-*/*/*.bb \
       	${LAYERDIR}/recipes-*/*/*.bbappend"
BBFILE_COLLECTIONS += "wvsnp-pkgs"
BBFILE_PATTERN_wvsnp-pkgs := "^${LAYERDIR}/"
BBFILE_PRIORITY_wvsnp-pkgs := "6"
```
